## meta-keya87-adaptation/conf/layer.conf
```bitbake
# We have a conf and classes directory, append to BBPATH
BBPATH .= ":${LAYERDIR}"

# add icc-runtime recipes to BBFILES
BBFILES += "${LAYERDIR}/recipes-*/*/*.bb \
            ${LAYERDIR}/recipes-*/*/*.bbappend"

#BBFILE_COLLECTIONS += "keya87-adaptation"
#BBFILE_PATTERN_keya87-adaption := "^${LAYERDIR}/"
#BBFILE_PRIORITY_keya87-adaption = "100"
```

## meta-keya87-bsp/conf/layer.conf
```bitbake
# We have a conf and classes directory, add to BBPATH
BBPATH .= ":${LAYERDIR}"

# We have a recipes-* directories, add to BBFILES
BBFILES += "${LAYERDIR}/recipes-*/*/*.bb \
	${LAYERDIR}/recipes-*/*/*.bbappend"

BBFILE_COLLECTIONS += "keya87-bsp"
BBFILE_PATTERN_keya87-bsp = "^${LAYERDIR}/"
BBFILE_PRIORITY_keya87-bsp = "6"

LAYERDEPENDS_keya87-bsp = "intel"
```

## meta-keya87-bsp/conf/machine/keya-87-uefi.conf
```bitbake
#@TYPE: Machine
#@NAME: keya-87

#@WEBTITLE: Intel Robotics Dev Kit -AAEONR-UP-BOARD- 64bit UEFI boot

#@DESCRIPTION: Machine configuration for AAEONR-UP-BOARD (keya87) 64-bit systems with UEFI bootloader

SERIAL_CONSOLES = "115200;ttyS0"
APPEND = "console=tty0 console=ttyS0,115200n8 clocksource=hpet"
```
